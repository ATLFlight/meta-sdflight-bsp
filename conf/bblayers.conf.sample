## conf/bblayers.conf.sample
```bitbake
# LAYER_CONF_VERSION is increased each time build/conf/bblayers.conf
# changes incompatibly
LCONF_VERSION = "6"

# FIXME Excelsior uses SOURCE, Eagle uses WORKSPACE, these need to be unified
export SOURCE := "${@os.path.abspath(os.path.join(os.path.dirname(bb.data.getVar('FILE', d)),'../..'))}"
export WORKSPACE := "${SOURCE}"

BBPATH = "${TOPDIR}"
BBFILES ?= ""

BBLAYERS ?= " \
  ${TOPDIR}/../poky/meta \
  ${TOPDIR}/../poky/meta-poky \
  ${TOPDIR}/../poky/meta-openembedded/meta-oe \
  ${TOPDIR}/../poky/meta-openembedded/meta-python \
  ${TOPDIR}/../poky/meta-openembedded/meta-networking \
  ${TOPDIR}/../poky/meta-sdflight-bsp \
  ${TOPDIR}/../poky/meta-qti-repackage \
  ${TOPDIR}/../poky/meta-repackage \
  ${TOPDIR}/../poky/meta-smartphone/meta-android \
  ${TOPDIR}/../poky/meta-ros \
  ${TOPDIR}/../poky/meta-nodejs \
  ${TOPDIR}/../poky/meta-nodejs-contrib \
  "
BBLAYERS_NON_REMOVABLE ?= " \
  ${TOPDIR}/../poky/meta \
  ${TOPDIR}/../poky/meta-poky \
  ${TOPDIR}/../poky/meta-openembedded/meta-oe \
  ${TOPDIR}/../poky/meta-sdflight-bsp \
  ${TOPDIR}/../poky/meta-qti-repackage \
  ${TOPDIR}/../poky/meta-repackage \
  ${TOPDIR}/../poky/meta-smartphone/meta-android \
  "
```

## conf/distro/apqlinux.conf
```bitbake
DISTRO_NAME = "APQLinux"
DISTRO_VERSION = "1.0"

GCCVERSION = "4.8%"
#TCMODE = "external-ubuntu"
#require include/tcmode-${TCMODE}.inc

#TCLIBC ?= "eglibc"
#require conf/distro/include/tclibc-${TCLIBC}.inc

# fastboot imaging commands
IMAGE_DEPENDS_fastboot = "mkbootimg-native virtual/kernel"
IMAGE_CMD_fastboot = "${STAGING_BINDIR_NATIVE}/mkbootimg --kernel ${STAGING_DIR_TARGET}/kernel/arch/arm/boot/Image --ramdisk /dev/null --ramdisk_offset $(awk --non-decimal-data '/ _end/ {end="0x" $1} /_stext/ {beg="0x" $1} END {size1=end-beg+4096; size=and(size1,compl(4095)); printf("%#x",size)}' ${STAGING_DIR_TARGET}/boot/System.map-${MACHINE_KERNEL_VERSION}) --cmdline 'root=${MACHINE_ROOTDEV} rw init=/sbin/init --verbose loglevel=7 rootwait console=${MACHINE_CONSOLE} no_console_suspend=1 androidboot.hardware=qcom log_buf_len=262144' --base ${MACHINE_KERNEL_BASE} ${EXTRA_IMAGECMD} --pagesize ${MACHINE_FLASH_PAGE_SIZE} --output ${DEPLOY_DIR_IMAGE}/${IMAGE_NAME}.rootfs.fastboot"
```

## conf/distro/include/tcmode-external-ubuntu.inc
```bitbake
#
# Configuration to use the standard ubuntu crossbuild toolchain.
#

EXTERNAL_TOOLCHAIN ?= "/usr"
TARGET_SYS_arm ?= "arm-linux-gnueabihf"

EXTERNAL_TOOLCHAIN ?= "/usr/local/csl/${TARGET_ARCH}"

TOOLCHAIN_PATH_ADD = "${EXTERNAL_TOOLCHAIN}/bin:"
PATH =. "${TOOLCHAIN_PATH_ADD}"

TARGET_PREFIX = "${TARGET_SYS}-"

ASSUME_PROVIDED = "\
	linux-libc-headers \
	linux-libc-headers-dev \
	virtual/linux-libc-headers \
	virtual/linux-libc-headers-dev \
	virtual/${TARGET_PREFIX}gcc \
	virtual/${TARGET_PREFIX}g++ \
	virtual/${TARGET_PREFIX}gcc-initial \
	virtual/${TARGET_PREFIX}gcc-intermediate \
	virtual/${TARGET_PREFIX}binutils \
	virtual/${TARGET_PREFIX}libc-for-gcc \
	virtual/${TARGET_PREFIX}libc-initial \
	virtual/${TARGET_PREFIX}compilerlibs \
	virtual/libc \
	virtual/libintl \
	virtual/libiconv \
	glibc-thread-db \
	libgcc \
	eglibc \
	virtual/linux-libc-headers \
	gdbserver \
"

# No need to re-compile the locale files
GLIBC_INTERNAL_USE_BINARY_LOCALE = "precompiled"
ENABLE_BINARY_LOCALE_GENERATION = ""
    
```

## conf/distro/qr-linux.conf
```bitbake
DISTRO = "qr-linux"
DISTRO_NAME = "QR Linux"
DISTRO_VERSION = "1.0"

GCCVERSION = "4.8%"
```

## conf/distro/sdflight.conf
```bitbake
DISTRO = "sdflight"
DISTRO_NAME = "SDFlight"
DISTRO_VERSION = "1.0"

DISTRO_FEATURES ?= "${DISTRO_FEATURES_LIBC} argp bluetooth ext2 largefile usbgadget usbhost wifi xattr 3g"

GCCVERSION = "6.2%"
```

## conf/layer.conf
```bitbake
# We have a conf and classes directory, add to BBPATH
BBPATH .= ":${LAYERDIR}"

# We have a recipes-* directories, add to BBFILES
BBFILES += "${LAYERDIR}/recipes-*/*/*.bb \
	${LAYERDIR}/recipes-*/*/*.bbappend"

BBFILE_COLLECTIONS += "sdflight"
BBFILE_PATTERN_sdflight = "^${LAYERDIR}/"
BBFILE_PRIORITY_sdflight = "6"

# Add our custom license directory
LICENSE_PATH += "${LAYERDIR}/files/common-licenses"
```

## conf/machine/sdflight.conf
```bitbake
#
# Copyright (c) 2014,2015 The Linux Foundation.
# All rights reserved.
#
# Redistribution and use in source and binary forms, with or without
# modification, are permitted (subject to the limitations in the
# disclaimer below) provided that the following conditions are met:
#
# * Redistributions of source code must retain the above copyright
#   notice, this list of conditions and the following disclaimer.
#
# * Redistributions in binary form must reproduce the above copyright
#   notice, this list of conditions and the following disclaimer in the
#   documentation and/or other materials provided with the distribution.
#
# * Neither the name of the Linux Foundation nor the names of its
#   contributors may be used to endorse or promote products derived from
#   this software without specific prior written permission.
#
# NO EXPRESS OR IMPLIED LICENSES TO ANY PARTY'S PATENT RIGHTS ARE
# GRANTED BY THIS LICENSE. THIS SOFTWARE IS PROVIDED BY THE COPYRIGHT
# HOLDERS AND CONTRIBUTORS "AS IS" AND ANY EXPRESS OR IMPLIED
# WARRANTIES, INCLUDING, BUT NOT LIMITED TO, THE IMPLIED WARRANTIES OF
# MERCHANTABILITY AND FITNESS FOR A PARTICULAR PURPOSE ARE
# DISCLAIMED. IN NO EVENT SHALL THE COPYRIGHT OWNER OR CONTRIBUTORS BE
# LIABLE FOR ANY DIRECT, INDIRECT, INCIDENTAL, SPECIAL, EXEMPLARY, OR
# CONSEQUENTIAL DAMAGES (INCLUDING, BUT NOT LIMITED TO, PROCUREMENT OF
# SUBSTITUTE GOODS OR SERVICES; LOSS OF USE, DATA, OR PROFITS; OR
# BUSINESS INTERRUPTION) HOWEVER CAUSED AND ON ANY THEORY OF LIABILITY,
# WHETHER IN CONTRACT, STRICT LIABILITY, OR TORT (INCLUDING NEGLIGENCE
# OR OTHERWISE) ARISING IN ANY WAY OUT OF THE USE OF THIS SOFTWARE, EVEN
# IF ADVISED OF THE POSSIBILITY OF SUCH DAMAGE.
#
#@TYPE: Machine
##@NAME: sdflight
##@DESCRIPTION: Machine configuration for sdflight
MACHINE_EXTRA_RRECOMMENDS = " kernel-modules"
require conf/machine/include/arm/arch-armv7a.inc
#IMAGE_FSTYPES += "ext4"
EXTRA_IMAGECMD_ext4 ?= "-i 4096 -b 4096"
#IMAGE_ROOTFS_SIZE ?= "16384"
KERNEL_IMAGETYPE ?= "zImage"
#KERNEL_DEVICETREE ?= ""
EAGLE_KERNEL_DTB = "apq8074pro-ab-eagle.dtb apq8074pro-ab-eagle-p2.dtb"
KERNEL_BASE ?= "0x80200000"
PAGE_SIZE ?= "2048"
RAMDISK_OFFSET ?= "0x02D00000"
#USE_VT = "0"

LK_ROOT_DEV = "/dev/mmcblk0p13"
LK_CMDLINE_OPTIONS += "prim_display=hdmi_msm"

KERNEL_CMDLINE ?= "console=ttyHSL0,115200,n8 root=${LK_ROOT_DEV} rw rootwait ${LK_CMDLINE_OPTIONS}"

SERIAL_CONSOLES = "115200;ttyHSL0"

PREFERRED_PROVIDER_virtual/kernel ?= "linux-sdflight"
PREFERRED_PROVIDER_kernel-module-wlan ?= "compat-wireless"
PREFERRED_PROVIDER_jpeg ?= "libjpeg-turbo"
PREFERRED_PROVIDER_jpeg-native ?= "jpeg-tative"
PREFERRED_VERSION_android-tools = "1.1.36"
PREFERRED_VERSION_android-tools-native = "1.1.36"
PREFERRED_VERSION_dtbtool-native = "1.1"
PREFERRED_VERSION_live555 = "1.0"

FEATURE_PACKAGES_sdflight-kernelmods = "compat-wireless"
#FEATURE_PACKAGES_ethernet-sdflight = "ethernet-sdflight"

IMAGE_FEATURES += "sdflight-kernelmods"

#MACHINE_FEATURES_BACKFILL_CONSIDERED = "hwclock"
PREBUILT_VERSION = "0.0.1"

# The platform depends on ipk packages
PACKAGE_CLASSES = "package_ipk"
```

## meta-eagle8074/conf/machine/eagle8074.conf
```bitbake
#
# Copyright (c) 2014,2015 The Linux Foundation.
# All rights reserved.
#
# Redistribution and use in source and binary forms, with or without
# modification, are permitted (subject to the limitations in the
# disclaimer below) provided that the following conditions are met:
#
# * Redistributions of source code must retain the above copyright
#   notice, this list of conditions and the following disclaimer.
#
# * Redistributions in binary form must reproduce the above copyright
#   notice, this list of conditions and the following disclaimer in the
#   documentation and/or other materials provided with the distribution.
#
# * Neither the name of the Linux Foundation nor the names of its
#   contributors may be used to endorse or promote products derived from
#   this software without specific prior written permission.
#
# NO EXPRESS OR IMPLIED LICENSES TO ANY PARTY'S PATENT RIGHTS ARE
# GRANTED BY THIS LICENSE. THIS SOFTWARE IS PROVIDED BY THE COPYRIGHT
# HOLDERS AND CONTRIBUTORS "AS IS" AND ANY EXPRESS OR IMPLIED
# WARRANTIES, INCLUDING, BUT NOT LIMITED TO, THE IMPLIED WARRANTIES OF
# MERCHANTABILITY AND FITNESS FOR A PARTICULAR PURPOSE ARE
# DISCLAIMED. IN NO EVENT SHALL THE COPYRIGHT OWNER OR CONTRIBUTORS BE
# LIABLE FOR ANY DIRECT, INDIRECT, INCIDENTAL, SPECIAL, EXEMPLARY, OR
# CONSEQUENTIAL DAMAGES (INCLUDING, BUT NOT LIMITED TO, PROCUREMENT OF
# SUBSTITUTE GOODS OR SERVICES; LOSS OF USE, DATA, OR PROFITS; OR
# BUSINESS INTERRUPTION) HOWEVER CAUSED AND ON ANY THEORY OF LIABILITY,
# WHETHER IN CONTRACT, STRICT LIABILITY, OR TORT (INCLUDING NEGLIGENCE
# OR OTHERWISE) ARISING IN ANY WAY OUT OF THE USE OF THIS SOFTWARE, EVEN
# IF ADVISED OF THE POSSIBILITY OF SUCH DAMAGE.
#

#@TYPE: Machine
#@NAME: eagle8074

#@DESCRIPTION: Machine configuration for eagle8074 systems

# Uncomment the following line to enable the hard floating point abi. Note that
# this breaks some binary libraries and 3D (neither of which ship with
# meta-yocto). For maximum compatibility, leave this disabled.
DEFAULTTUNE ?= "cortexa8hf-neon"
include conf/machine/include/tune-cortexa8.inc

MACHINE_ARCH = "arm"
HOST_OS = "linux-gnueabihf"
DPKG_ARCH = "armhf"

SERIAL_CONSOLE = "115200 ttyHSL0"
LK_ROOT_DEV = "/dev/mmcblk0p13"
LK_CMDLINE_OPTIONS += "prim_display=hdmi_msm"

PREFERRED_PROVIDER_virtual/kernel ?= "linux-qr-eagle8074"
PREFERRED_PROVIDER_kernel-module-wlan ?= "kernel-module-wlan"
PREFERRED_PROVIDER_kernel-module-cfg80211 ?= "linux-qr-eagle8074"

#KERNEL_DEVICETREE = "apq8074-v2.2-dragonboard.dtb"
QRLINUX_DTB = "apq8074pro-ab-eagle.dtb"
#QRLINUX_DTB = "msm8974pro-ab-pm8941-npc.dtb" 

PACKAGE_GROUP_eagle8074-kernelmods = "kernel-module-wlan kernel-module-cfg80211"
MULTISTRAP_SECTION_eagle8074-kernelmods = "Modules"

PACKAGE_GROUP_ethernet-eagle8074 = "ethernet-eagle8074"

IMAGE_FEATURES += "eagle8074-kernelmods ethernet-eagle8074"

# Change the compiler
GCCVERSION = "4.8%"
```

## meta-ifc6410/conf/layer.conf
```bitbake
# We have a conf and classes directory, add to BBPATH
BBPATH .= ":${LAYERDIR}"

# We have a recipes-* directories, add to BBFILES
BBFILES += "${LAYERDIR}/recipes-*/*/*.bb \
	${LAYERDIR}/recipes-*/*/*.bbappend"

BBFILE_COLLECTIONS += "ifc6410"
BBFILE_PATTERN_ifc6410 = "^${LAYERDIR}/"
BBFILE_PRIORITY_ifc6410 = "6"
```

## meta-ifc6410/conf/machine/ifc6410.conf
```bitbake
#@TYPE: Machine
#@NAME: ifc6410

#@DESCRIPTION: Machine configuration for ifc6410 systems

# Uncomment the following line to enable the hard floating point abi. Note that
# this breaks some binary libraries and 3D (neither of which ship with
# meta-yocto). For maximum compatibility, leave this disabled.
DEFAULTTUNE ?= "cortexa8hf-neon"
include conf/machine/include/tune-cortexa8.inc

MACHINE_ARCH = "arm"
HOST_OS = "linux-gnueabihf"
DPKG_ARCH = "armhf"

SERIAL_CONSOLE = "115200 ttyHSL0"
LK_ROOT_DEV = "/dev/mmcblk0p13"
LK_CMDLINE_OPTIONS += "prim_display=hdmi_msm"

PREFERRED_PROVIDER_virtual/kernel ?= "linux-qr-ifc6410"
PREFERRED_PROVIDER_kernel-module-wlan ?= "compat-wireless"
PREFERRED_PROVIDER_kernel-module-cfg80211 ?= "compat-wireless"

PACKAGE_GROUP_ifc6410-kernelmods += "compat-wireless kernel-module-wlan kernel-module-cfg80211"
MULTISTRAP_SECTION_ifc6410-kernelmods = "Modules"

PACKAGE_GROUP_ethernet-ifc6410 += "ethernet-ifc6410"

IMAGE_FEATURES += "ifc6410-kernelmods ethernet-ifc6410"

PACKAGE_GROUP_ath3k-bluez += "ath3k-bluez"
IMAGE_FEATURES += "ath3k-bluez"

# Change the compiler
GCCVERSION = "4.8%"
```

## meta-liquid8064/conf/layer.conf
```bitbake
# We have a conf and classes directory, add to BBPATH
BBPATH .= ":${LAYERDIR}"

# We have a recipes-* directories, add to BBFILES
BBFILES += "${LAYERDIR}/recipes-*/*/*.bb \
	${LAYERDIR}/recipes-*/*/*.bbappend"

BBFILE_COLLECTIONS += "liquid8064"
BBFILE_PATTERN_liquid8064 = "^${LAYERDIR}/"
BBFILE_PRIORITY_liquid8064 = "6"
```

## meta-liquid8064/conf/machine/liquid8064.conf
```bitbake
#@TYPE: Machine
#@NAME: liquid8064

#@DESCRIPTION: Machine configuration for liquid8064 systems

# Ship all kernel modules by default
MACHINE_EXTRA_RRECOMMENDS = "kernel-modules"
MACHINE_EXTRA_RDEPENDS += "kernel-module-wlan"

# Uncomment the following line to enable the hard floating point abi. Note that
# this breaks some binary libraries and 3D (neither of which ship with
# meta-yocto). For maximum compatibility, leave this disabled.
DEFAULTTUNE ?= "cortexa8hf-neon"
include conf/machine/include/tune-cortexa8.inc

MACHINE_ARCH = "arm"
HOST_OS = "linux-gnueabihf"
DPKG_ARCH = "armhf"

# 2.6.37 and later kernels use OMAP_SERIAL, ttyO2
# earlier kernels use ttyS2
SERIAL_CONSOLE = "115200 ttyO2"

PREFERRED_PROVIDER_virtual/kernel ?= "linux-yocto-custom"


#KERNEL_IMAGETYPE = "zImage"

#MACHINE_FEATURES = "usbgadget usbhost vfat alsa"

# Change the compiler
GCCVERSION = "4.7%"
```

## meta-som8064/conf/layer.conf
```bitbake
# We have a conf and classes directory, add to BBPATH
BBPATH .= ":${LAYERDIR}"

# We have a recipes-* directories, add to BBFILES
BBFILES += "${LAYERDIR}/recipes-*/*/*.bb \
	${LAYERDIR}/recipes-*/*/*.bbappend"

BBFILE_COLLECTIONS += "som8064"
BBFILE_PATTERN_som8064 = "^${LAYERDIR}/"
BBFILE_PRIORITY_som8064 = "6"
```

## meta-som8064/conf/machine/som8064-const.conf
```bitbake
#
# Copyright (c) 2014,2015 The Linux Foundation.
# All rights reserved.
#
# Redistribution and use in source and binary forms, with or without
# modification, are permitted (subject to the limitations in the
# disclaimer below) provided that the following conditions are met:
#
# * Redistributions of source code must retain the above copyright
#   notice, this list of conditions and the following disclaimer.
#
# * Redistributions in binary form must reproduce the above copyright
#   notice, this list of conditions and the following disclaimer in the
#   documentation and/or other materials provided with the distribution.
#
# * Neither the name of the Linux Foundation nor the names of its
#   contributors may be used to endorse or promote products derived from
#   this software without specific prior written permission.
#
# NO EXPRESS OR IMPLIED LICENSES TO ANY PARTY'S PATENT RIGHTS ARE
# GRANTED BY THIS LICENSE. THIS SOFTWARE IS PROVIDED BY THE COPYRIGHT
# HOLDERS AND CONTRIBUTORS "AS IS" AND ANY EXPRESS OR IMPLIED
# WARRANTIES, INCLUDING, BUT NOT LIMITED TO, THE IMPLIED WARRANTIES OF
# MERCHANTABILITY AND FITNESS FOR A PARTICULAR PURPOSE ARE
# DISCLAIMED. IN NO EVENT SHALL THE COPYRIGHT OWNER OR CONTRIBUTORS BE
# LIABLE FOR ANY DIRECT, INDIRECT, INCIDENTAL, SPECIAL, EXEMPLARY, OR
# CONSEQUENTIAL DAMAGES (INCLUDING, BUT NOT LIMITED TO, PROCUREMENT OF
# SUBSTITUTE GOODS OR SERVICES; LOSS OF USE, DATA, OR PROFITS; OR
# BUSINESS INTERRUPTION) HOWEVER CAUSED AND ON ANY THEORY OF LIABILITY,
# WHETHER IN CONTRACT, STRICT LIABILITY, OR TORT (INCLUDING NEGLIGENCE
# OR OTHERWISE) ARISING IN ANY WAY OUT OF THE USE OF THIS SOFTWARE, EVEN
# IF ADVISED OF THE POSSIBILITY OF SUCH DAMAGE.
#

#@TYPE: Machine
#@NAME: som8064-const

#@DESCRIPTION: Machine configuration for som8064-const systems

DEFAULTTUNE ?= "cortexa8hf-neon"
include conf/machine/include/tune-cortexa8.inc

MACHINE_ARCH = "arm"
HOST_OS = "linux-gnueabihf"
DPKG_ARCH = "armhf"

SERIAL_CONSOLE = "115200 ttyHSL1"
LK_ROOT_DEV = "/dev/mmcblk0p13"
LK_CMDLINE_OPTIONS += "prim_display=hdmi_msm"

PREFERRED_PROVIDER_virtual/kernel ?= "linux-qr-som8064"
PREFERRED_PROVIDER_kernel-module-wlan ?= "kernel-module-wlan"
PREFERRED_PROVIDER_kernel-module-cfg80211 ?= "linux-qr-som8064-const"

# Change the compiler
GCCVERSION = "4.8%"
```
