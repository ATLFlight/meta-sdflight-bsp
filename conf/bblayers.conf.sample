## meta-som8064/conf/machine/som8064.conf
```bitbake
#@TYPE: Machine
#@NAME: som8064

#@DESCRIPTION: Machine configuration for som8064 systems

# Uncomment the following line to enable the hard floating point abi. Note that
# this breaks some binary libraries and 3D (neither of which ship with
# meta-yocto). For maximum compatibility, leave this disabled.
DEFAULTTUNE ?= "cortexa8hf-neon"
include conf/machine/include/tune-cortexa8.inc

MACHINE_ARCH = "arm"
HOST_OS = "linux-gnueabihf"
DPKG_ARCH = "armhf"

SERIAL_CONSOLE = "115200 ttyHSL1"
LK_ROOT_DEV = "/dev/mmcblk0p13"
LK_CMDLINE_OPTIONS += "prim_display=hdmi_msm"

PREFERRED_PROVIDER_virtual/kernel ?= "linux-qr-som8064"
PREFERRED_PROVIDER_kernel-module-wlan ?= "kernel-module-wlan"
PREFERRED_PROVIDER_kernel-module-cfg80211 ?= "linux-qr-som8064"

PACKAGE_GROUP_som8064-kernelmods = "kernel-module-wlan kernel-module-cfg80211"
MULTISTRAP_SECTION_som8064-kernelmods = "Modules"

IMAGE_FEATURES += "som8064-kernelmods"

# Change the compiler
GCCVERSION = "4.7%"
```
